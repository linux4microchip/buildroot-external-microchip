## board/microchip/polarberry/fitimage_polarberry.its
```
/dts-v1/;

/ {
	description = "Linux fitImage for Polaberry";
	#address-cells = <1>;

	images {
		kernel-0 {
			description = "Linux Kernel";
			data = /incbin/("images/Image");
			type = "kernel";
			arch = "riscv";
			os = "linux";
			compression = "none";
			load = <0x80200000>;
			entry = <0x80200000>;
			hash-1 {
				algo = "sha256";
			};
		};

		fdt-0 {
			description = "Flattened Device Tree blob";
			data = /incbin/("images/linux_polarberry.dtb");
			type = "flat_dt";
			arch = "riscv";
			compression = "none";
			hash-1 {
				algo = "sha256";
			};
		};

		ramdisk-0 {
			description = "ramdisk";
			data = /incbin/("images/rootfs.cpio.bz2");
			type = "ramdisk";
			arch = "arm64";
			os = "linux";
			compression = "none";
			hash-1 {
				algo = "sha256";
			};
		};
	};

	configurations {
		default = "conf-1";
		conf-1 {
			description = "Boot Linux kernel with FDT blob + ramdisk";
			kernel = "kernel-0";
			fdt = "fdt-0";
			ramdisk = "ramdisk-0";
			hash-1 {
				algo = "sha256";
			};
		};
		conf-2 {
			description = "Boot Linux kernel with FDT blob";
			kernel = "kernel-0";
			fdt = "fdt-0";
			hash-1 {
				algo = "sha256";
			};
		};
	};
};
```

## board/microchip/som1-soc/linux/linux_som1-soc_defconfig
```kconfig
CONFIG_SYSVIPC=y
CONFIG_POSIX_MQUEUE=y
CONFIG_NO_HZ_IDLE=y
CONFIG_HIGH_RES_TIMERS=y
CONFIG_BPF_SYSCALL=y
CONFIG_IKCONFIG=y
CONFIG_IKCONFIG_PROC=y
CONFIG_CGROUPS=y
CONFIG_CGROUP_SCHED=y
CONFIG_CFS_BANDWIDTH=y
CONFIG_CGROUP_BPF=y
CONFIG_BLK_DEV_INITRD=y
CONFIG_EXPERT=y
CONFIG_KALLSYMS_ALL=y
CONFIG_SOC_MICROCHIP_POLARFIRE=y
CONFIG_SMP=y
CONFIG_CMDLINE="earlycon debug uio_pdrv_genirq.of_id=generic-uio"
CONFIG_JUMP_LABEL=y
# CONFIG_GCC_PLUGINS is not set
CONFIG_MODULES=y
CONFIG_MODULE_UNLOAD=y
CONFIG_BLK_DEV_ZONED=y
CONFIG_NET=y
CONFIG_PACKET=y
CONFIG_UNIX=y
CONFIG_INET=y
CONFIG_CAN=y
CONFIG_PCI=y
CONFIG_PCI_HOST_GENERIC=y
CONFIG_PCIE_MICROCHIP_HOST=y
CONFIG_DEVTMPFS=y
CONFIG_DEVTMPFS_MOUNT=y
CONFIG_MTD=y
CONFIG_MTD_SPI_NAND=y
CONFIG_MTD_SPI_NOR=y
CONFIG_OF_OVERLAY=y
CONFIG_BLK_DEV_LOOP=y
CONFIG_BLK_DEV_NVME=y
CONFIG_MPFS_DMA_PROXY=y
CONFIG_SCSI=y
CONFIG_BLK_DEV_SD=y
CONFIG_NETDEVICES=y
CONFIG_MACB=y
CONFIG_MICREL_PHY=y
CONFIG_MICROSEMI_PHY=y
CONFIG_SERIAL_8250=y
CONFIG_SERIAL_8250_CONSOLE=y
CONFIG_SERIAL_OF_PLATFORM=y
CONFIG_SERIAL_EARLYCON_RISCV_SBI=y
CONFIG_HW_RANDOM=y
CONFIG_HW_RANDOM_POLARFIRE_SOC=y
CONFIG_I2C=y
CONFIG_I2C_CHARDEV=y
CONFIG_I2C_MUX=m
CONFIG_I2C_MICROCHIP_CORE=y
CONFIG_SPI=y
CONFIG_SPI_DEBUG=y
CONFIG_SPI_MICROCHIP_CORE=y
CONFIG_SPI_MICROCHIP_CORE_QSPI=y
CONFIG_SPI_SPIDEV=y
CONFIG_GPIOLIB=y
CONFIG_GPIO_SYSFS=y
CONFIG_GPIO_POLARFIRE_SOC=y
CONFIG_POWER_RESET=y
CONFIG_PMBUS=m
CONFIG_USB=y
CONFIG_USB_XHCI_HCD=y
CONFIG_USB_XHCI_PLATFORM=y
CONFIG_USB_EHCI_HCD=y
CONFIG_USB_EHCI_HCD_PLATFORM=y
CONFIG_USB_OHCI_HCD=y
CONFIG_USB_OHCI_HCD_PLATFORM=y
CONFIG_USB_ACM=m
CONFIG_USB_STORAGE=m
CONFIG_USB_MUSB_HDRC=y
CONFIG_USB_MUSB_POLARFIRE_SOC=y
CONFIG_USB_INVENTRA_DMA=y
CONFIG_USB_SERIAL=m
CONFIG_NOP_USB_XCEIV=y
CONFIG_MMC=y
CONFIG_MMC_SDHCI=y
CONFIG_MMC_SDHCI_PLTFM=y
CONFIG_MMC_SDHCI_CADENCE=y
CONFIG_MMC_SPI=y
CONFIG_RTC_CLASS=y
CONFIG_RTC_DRV_POLARFIRE_SOC=y
CONFIG_DMADEVICES=y
CONFIG_SF_PDMA=y
CONFIG_UIO=y
CONFIG_UIO_PDRV_GENIRQ=y
CONFIG_UIO_DMEM_GENIRQ=y
# CONFIG_VHOST_MENU is not set
CONFIG_POLARFIRE_SOC_MAILBOX=y
CONFIG_REMOTEPROC=y
CONFIG_REMOTEPROC_CDEV=y
CONFIG_MIV_REMOTEPROC=y
CONFIG_RPMSG_CHAR=m
CONFIG_RPMSG_MIV=y
CONFIG_RPMSG_MIV_TTY=m
CONFIG_RPMSG_VIRTIO=y
CONFIG_POLARFIRE_SOC_SYS_CTRL=y
CONFIG_POLARFIRE_SOC_GENERIC_SERVICE=y
CONFIG_EXT4_FS=y
CONFIG_EXT4_FS_POSIX_ACL=y
CONFIG_FANOTIFY=y
CONFIG_MSDOS_FS=m
CONFIG_VFAT_FS=m
CONFIG_FAT_DEFAULT_IOCHARSET="ascii"
CONFIG_EXFAT_FS=m
CONFIG_TMPFS=y
CONFIG_TMPFS_POSIX_ACL=y
CONFIG_CONFIGFS_FS=y
CONFIG_NFS_FS=m
CONFIG_NFS_V4=m
CONFIG_NFS_V4_1=y
CONFIG_NFS_V4_2=y
CONFIG_NLS_CODEPAGE_437=m
CONFIG_NLS_CODEPAGE_850=m
CONFIG_NLS_ASCII=m
CONFIG_NLS_ISO8859_1=m
CONFIG_NLS_UTF8=m
CONFIG_PRINTK_TIME=y
CONFIG_DEBUG_FS=y
CONFIG_SCHED_STACK_END_CHECK=y
CONFIG_SOFTLOCKUP_DETECTOR=y
CONFIG_WQ_WATCHDOG=y
CONFIG_SCHEDSTATS=y
CONFIG_DEBUG_SPINLOCK=y
CONFIG_STACKTRACE=y
CONFIG_SAMPLES=y
CONFIG_SAMPLE_RPMSG_CLIENT=m
```

## configs/sundancedsp_polarberry_defconfig
```kconfig
BR2_riscv=y
BR2_riscv_custom=y
BR2_RISCV_ISA_CUSTOM_RVM=y
BR2_RISCV_ISA_CUSTOM_RVA=y
BR2_RISCV_ISA_CUSTOM_RVF=y
BR2_RISCV_ISA_CUSTOM_RVD=y
BR2_RISCV_ISA_CUSTOM_RVC=y
BR2_KERNEL_HEADERS_5_15=y
BR2_BINUTILS_VERSION_2_39_X=y
BR2_GCC_VERSION_11_X=y
BR2_TOOLCHAIN_BUILDROOT_CXX=y
BR2_PACKAGE_HOST_GDB=y
BR2_SHARED_STATIC_LIBS=y
BR2_GLOBAL_PATCH_DIR="$(BR2_EXTERNAL_MCHP_PATH)/board/microchip/polarberry/patches/"
BR2_TARGET_GENERIC_HOSTNAME="POLARBERRY"
BR2_TARGET_GENERIC_ISSUE="Welcome to POLARBERRY Linux"
BR2_TARGET_GENERIC_ROOT_PASSWD="root"
BR2_ROOTFS_OVERLAY="$(BR2_EXTERNAL_MCHP_PATH)/board/microchip/polarberry/rootfs_overlay"
BR2_ROOTFS_POST_IMAGE_SCRIPT="$(BR2_EXTERNAL_MCHP_PATH)/board/microchip/polarberry/post-image.sh"
BR2_LINUX_KERNEL=y
BR2_LINUX_KERNEL_CUSTOM_GIT=y
BR2_LINUX_KERNEL_CUSTOM_REPO_URL="https://github.com/linux4microchip/linux.git"
BR2_LINUX_KERNEL_CUSTOM_REPO_VERSION="linux-5.15-mchp"
BR2_LINUX_KERNEL_USE_CUSTOM_CONFIG=y
BR2_LINUX_KERNEL_CUSTOM_CONFIG_FILE="$(BR2_EXTERNAL_MCHP_PATH)/board/microchip/polarberry/linux/linux_polarberry_defconfig"
BR2_LINUX_KERNEL_DTS_SUPPORT=y
BR2_LINUX_KERNEL_CUSTOM_DTS_PATH="$(BR2_EXTERNAL_MCHP_PATH)/board/microchip/polarberry/linux/linux_polarberry.dts"
BR2_PACKAGE_LINUX_TOOLS_GPIO=y
BR2_PACKAGE_SPIDEV_TEST=y
BR2_PACKAGE_SPI_TOOLS=y
BR2_PACKAGE_LIBSYSFS=y
BR2_PACKAGE_JPEG_TURBO=y
BR2_PACKAGE_LIBSVG_CAIRO=y
BR2_PACKAGE_DROPBEAR=y
# BR2_PACKAGE_DROPBEAR_CLIENT is not set
BR2_PACKAGE_UTIL_LINUX_MOUNT=y
BR2_TARGET_ROOTFS_CPIO=y
BR2_TARGET_ROOTFS_CPIO_BZIP2=y
# BR2_TARGET_ROOTFS_TAR is not set
BR2_TARGET_UBOOT=y
BR2_TARGET_UBOOT_BUILD_SYSTEM_KCONFIG=y
BR2_TARGET_UBOOT_CUSTOM_GIT=y
BR2_TARGET_UBOOT_CUSTOM_REPO_URL="https://github.com/polarfire-soc/u-boot.git"
BR2_TARGET_UBOOT_CUSTOM_REPO_VERSION="mpfs-uboot-2023.07-next"
BR2_TARGET_UBOOT_USE_CUSTOM_CONFIG=y
BR2_TARGET_UBOOT_CUSTOM_CONFIG_FILE="$(BR2_EXTERNAL_MCHP_PATH)/board/microchip/polarberry/uboot/uboot_polarberry_defconfig"
BR2_TARGET_UBOOT_NEEDS_DTC=y
BR2_TARGET_UBOOT_CUSTOM_DTS_PATH="$(BR2_EXTERNAL_MCHP_PATH)/board/microchip/polarberry/uboot/uboot_polarberry.dts"
BR2_PACKAGE_HOST_DOSFSTOOLS=y
BR2_PACKAGE_HOST_E2FSPROGS=y
BR2_PACKAGE_HOST_GENIMAGE=y
BR2_PACKAGE_HOST_MTOOLS=y
BR2_PACKAGE_HOST_HSS_PAYLOAD_GENERATOR=y
BR2_PACKAGE_HOST_HSS_PAYLOAD_GENERATOR_CFG="$(BR2_EXTERNAL_MCHP_PATH)/board/microchip/polarberry/HSS_payload_config"
BR2_PACKAGE_HOST_HSS_PAYLOAD_GENERATOR_SRC="output/images/u-boot.bin"
BR2_PACKAGE_HART_SOFTWARE_SERVICES=y
```

## package/hart-software-services/Config.in
```kconfig
config BR2_PACKAGE_HART_SOFTWARE_SERVICES
	bool "HSS (Hart-Software-Services) Microsemi First Stage Bootloader"
	help
	  Microchip Hart Software Services package for PolarFire SOC.

if BR2_PACKAGE_HART_SOFTWARE_SERVICES

config BR2_PACKAGE_HART_SOFTWARE_SERVICES_CONFIG
	string "Path to the HSS config file"
	help
	  Set here the PATH to the HSS config file

config BR2_PACKAGE_HART_SOFTWARE_SERVICES_BOARD
	string "Name of the board"
	help
	  Set here name of the board you have

config BR2_PACKAGE_HART_SOFTWARE_SERVICES_DIE
	string "DIE Setting"
	help
	  Set here the CHIP setting

config BR2_PACKAGE_HART_SOFTWARE_SERVICES_PACKAGE
	string "PACKAGE Setting"
	help
	  Set here PACKAGE setting
endif
```
